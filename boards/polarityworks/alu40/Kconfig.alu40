## boards/polarityworks/alu40/Kconfig.alu40
```kconfig
# ALU40 board configuration

# Copyright (c) 2022 Polarity Works
# SPDX-License-Identifier: MIT

config BOARD_ALU40
    select SOC_NRF52840_QIAA
    select ZMK_BOARD_COMPAT
    imply RETAINED_MEM
    imply RETENTION
    imply RETENTION_BOOT_MODE
```

## boards/polarityworks/alu40/Kconfig.defconfig
```kconfig
# ALU40 keyboard configuration

# Copyright (c) 2021 Polarity Works
# SPDX-License-Identifier: MIT

config ZMK_KEYBOARD_NAME
    default "ALU40" if BOARD_ALU40

if BOARD_ALU40

if USB

config USB_NRFX
    default y

config USB_DEVICE_STACK
    default y

endif # USB

config BT_CTLR
    default BT

endif # BOARD_ALU40
```

## boards/polarityworks/alu40/alu40_nrf52840_zmk_defconfig
```kconfig
# SPDX-License-Identifier: MIT

# Enable MPU
CONFIG_ARM_MPU=y

# Enable GPIO and pin control
CONFIG_GPIO=y
CONFIG_PINCTRL=y

# Encoder
CONFIG_EC11=y
CONFIG_EC11_TRIGGER_GLOBAL_THREAD=y

# Use the application partition defined by the Adafruit bootloader layout
CONFIG_USE_DT_CODE_PARTITION=y
CONFIG_BUILD_OUTPUT_UF2=y

# Settings storage
CONFIG_MPU_ALLOW_FLASH_WRITE=y
CONFIG_NVS=y
CONFIG_SETTINGS_NVS=y
CONFIG_FLASH=y
CONFIG_FLASH_PAGE_LAYOUT=y
CONFIG_FLASH_MAP=y

# Underglow defaults
CONFIG_ZMK_RGB_UNDERGLOW=y
CONFIG_ZMK_RGB_UNDERGLOW_EXT_POWER=y
CONFIG_ZMK_RGB_UNDERGLOW_ON_START=n
CONFIG_ZMK_RGB_UNDERGLOW_HUE_START=262

# Preserve the board's existing Bluetooth connection defaults
CONFIG_BT_PRIVACY=y
CONFIG_BT_GAP_PERIPHERAL_PREF_PARAMS=y
CONFIG_BT_PERIPHERAL_PREF_TIMEOUT=600
CONFIG_BT_PERIPHERAL_PREF_MIN_INT=12
CONFIG_BT_PERIPHERAL_PREF_MAX_INT=24
CONFIG_BT_PERIPHERAL_PREF_LATENCY=30

CONFIG_ZMK_USB=y
CONFIG_ZMK_BLE=y
```

## boards/polarityworks/alu40/board.yml
```yaml
board:
  name: alu40
  vendor: polarityworks
  socs:
    - name: nrf52840
      variants:
        - name: zmk
```

## config/west.yml
```yaml
manifest:
  remotes:
    - name: zmkfirmware
      url-base: https://github.com/zmkfirmware
  projects:
    - name: zmk
      remote: zmkfirmware
      revision: 61291c58fd3c982a884f940776b169d1fce14fc8
      import: app/west.yml
  self:
    path: config
```
